## package/batocera/emulationstation/es-theme-carbon/Config.in
```kconfig
config BR2_PACKAGE_ES_THEME_CARBON
	bool "EmulationStation theme minima (Batocera version)"
	help
	  https://github.com/soaremicheledavid/ES-Theme-MINIMA
```

## package/batocera/emulationstation/es-theme-epic-dark/Config.in
```kconfig
config BR2_PACKAGE_ES_THEME_EPIC_DARK
	bool "EmulationStation theme epic dark (Batocera version)"
	help
	  https://github.com/torresflo/ES-Theme-Epic-Dark
```

## package/batocera/emulationstation/es-theme-minima/Config.in
```kconfig
config BR2_PACKAGE_ES_THEME_MINIMA
	bool "EmulationStation theme minima (Batocera version)"
	help
	  https://github.com/soaremicheledavid/ES-Theme-MINIMA
```

## package/batocera/emulationstation/es-theme-minulli/Config.in
```kconfig
config BR2_PACKAGE_ES_THEME_MINULLI
	bool "EmulationStation theme minulli (Batocera version)"
	help
	    https://github.com/ajmandourah/es-theme-minulli
```

## package/batocera/emulationstation/es-theme-tft/Config.in
```kconfig
config BR2_PACKAGE_ES_THEME_TFT
	bool "EmulationStation theme tft (Batocera version)"
	help
	  https://github.com/ajmandourah/ES-Theme-tft
```

## package/batocera/emulators/retroarch/libretro/libretro-flycast-xtreme/Config.in
```kconfig
config BR2_PACKAGE_LIBRETRO_FLYCAST_XTREME
        bool "libretro-flycast-xtreme"
	depends on BR2_PACKAGE_RETROARCH
	depends on BR2_INSTALL_LIBSTDCPP
	depends on BR2_GCC_ENABLE_OPENMP
        help
          A libretro dreamcast emulator core.

	  http://www.libretro.com

comment "LIBRETRO_FLYCAST_XTREME needs a toolchain w/ C++"
	depends on !BR2_INSTALL_LIBSTDCPP
```
